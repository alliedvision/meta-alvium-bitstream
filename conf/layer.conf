## conf/layer.conf
```bitbake
# We have a conf and classes directory, add to BBPATH
BBPATH .= ":${LAYERDIR}"

# We have recipes-* directories, add to BBFILES
BBFILES += "${LAYERDIR}/recipes-*/*/*.bb \
            ${LAYERDIR}/recipes-*/*/*.bbappend"

BBFILE_COLLECTIONS += "meta-alvium-bitstream"
BBFILE_PATTERN_meta-alvium-bitstream = "^${LAYERDIR}/"
BBFILE_PRIORITY_meta-alvium-bitstream = "6"

LAYERDEPENDS_meta-alvium-bitstream = "core"
LAYERSERIES_COMPAT_meta-alvium-bitstream = "kirkstone langdale"
```
